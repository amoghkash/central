## CMakeLists.txt
```
cmake_minimum_required(VERSION 3.20.0)

# Include Zephyr boilerplate
find_package(Zephyr REQUIRED HINTS $ENV{ZEPHYR_BASE})
project(central)

# Add source files
# target_sources(app PRIVATE
#     src/main.c
#     src/ot/mesh.c
#     src/ot/handler.c
#     src/utils/peripherals.c
# )

target_include_directories(app PRIVATE src/include)

file(GLOB_RECURSE SOURCES "${CMAKE_CURRENT_SOURCE_DIR}/src/*.c")
target_sources(app PRIVATE ${SOURCES})
```

## Kconfig
```
# SPDX-License-Identifier: Apache-2.0
menu "Zephyr Kernel"
    source "Kconfig.zephyr"
endmenu

menu "Application Settings"

config APP_NETWORKING
    bool "Networking"
    default y
    help
        Enables networking within the system.


menu "Thread & CoAP Settings"
    config ENABLE_OT_SHELL
        bool "Enable CLI to interact with OpenThread"
        select CONFIG_OPENTHREAD_SHELL
        depends on CONFIG_SHELL

endmenu

endmenu
```

## prj.conf
```kconfig
# Author: Amogh Kashyap
# Use Thread
CONFIG_NETWORKING=y             # Enables Generic Link Layer and IP Networking Support
CONFIG_NET_L2_OPENTHREAD=y      # Enables OpenThread Stack
CONFIG_MPSL=y                   # Enables the Multiprotocol Service Layer (MPSL) implementation

# Enable CoAP
CONFIG_COAP=y                   # Enable CoAP
CONFIG_COAP_UTILS=y             # Enable CoAP Utilities

# OpenThread Configuration
CONFIG_OPENTHREAD_COAP=y        # Enable OpenThread CoAP ApI

# Network Configuration
CONFIG_SHELL=y                  # Enable Shell on Device
CONFIG_OPENTHREAD_SHELL=y       # Link OpenThread to CLI
CONFIG_SHELL_ARGC_MAX=26
CONFIG_SHELL_CMD_BUFF_SIZE=416
CONFIG_NET_SOCKETS=y            # Enable Network Sockets
CONFIG_POSIX_API=y              # Use POSIX API for Network API
CONFIG_NET_SOCKETS_POLL_MAX=4


# Update Device Settings
CONFIG_FPU=y                    # Enable Floating Point Unit
CONFIG_MBEDTLS_SHA1_C=n         # Disable MBED TLS in favor of CryptoCell

# Increase Settings storage size
CONFIG_PM_PARTITION_SIZE_SETTINGS_STORAGE=0x4000 
```

## base.conf
```kconfig
# Enable Logging and Printing
CONFIG_PRINTK=y                 # Enable Printing to Console
CONFIG_LOG=y                    # Enable Logging Module


# Update Device Settings
CONFIG_FPU=y                    # Enable Floating Point Unit
CONFIG_MBEDTLS_SHA1_C=n         # Disable MBED TLS in favor of CryptoCell

# Shell Configuration
CONFIG_SHELL=n                  # Enable Shell on Device
CONFIG_SHELL_ARGC_MAX=26
CONFIG_SHELL_CMD_BUFF_SIZE=416
```

## network.conf
```kconfig
# Author: Amogh Kashyap
# Use Thread
CONFIG_NETWORKING=y             # Enables Generic Link Layer and IP Networking Support
CONFIG_NET_L2_OPENTHREAD=y      # Enables OpenThread Stack
CONFIG_MPSL=y                   # Enables the Multiprotocol Service Layer (MPSL) implementation


# Enable CoAP
CONFIG_COAP=y                   # Enable CoAP
CONFIG_COAP_UTILS=y             # Enable CoAP Utilities
CONFIG_COAP_SERVER=y

# OpenThread Configuration
CONFIG_OPENTHREAD_COAP=y        # Enable OpenThread CoAP ApI

# General Network Configuration
CONFIG_NET_SOCKETS=y            # Enable Network Sockets
CONFIG_POSIX_API=y              # Use POSIX API for Network API

# CONFIG_NET_IPV6=y
# CONFIG_NET_UDP=y
# CONFIG_COAP=y
# CONFIG_NET_SOCKETS=y
# CONFIG_NET_SOCKETS_POSIX_NAMES=y
# CONFIG_NET_CONFIG_SETTINGS=y
# CONFIG_NET_CONFIG_NEED_IPV6=y
# CONFIG_NET_CONFIG_AUTO_INIT=y
# CONFIG_NET_CONFIG_MY_IPV6_ADDR="2001:db8::1"

# Client Config
CONFIG_COAP=y
CONFIG_NETWORKING=y
CONFIG_NET_IPV6=y
CONFIG_NET_UDP=y
CONFIG_NET_SOCKETS=y
CONFIG_NET_SOCKETS_POSIX_NAMES=y
CONFIG_NET_CONFIG_NEED_IPV6=y
CONFIG_NET_CONFIG_SETTINGS=y
```

## src/main.c
```c
#include <zephyr/kernel.h>
#include <zephyr/logging/log.h>
#include "coap_server.h"
#include "coap_client.h"

int server = 0;

int main(void)
{
    if (server) {
        printk("Starting CoAP Server\n");
        start_coap_server();
    } else {
        printk("Starting CoAP Client\n");
        send_coap_request("2001:db8::1", "hello");
    }
    return 0;
}
```

## src/coap_client.c
```c
#include <zephyr/net/coap.h>
#include <zephyr/net/socket.h>
#include <zephyr/logging/log.h>
#include "coap_client.h"

LOG_MODULE_REGISTER(coap_client, LOG_LEVEL_INF);

#define SERVER_PORT 5683
#define MAX_BUF_LEN 128

void send_coap_request(const char *server_ip, const char *resource_path)
{
    int sock;
    struct sockaddr_in6 server_addr;
    uint8_t request_buf[MAX_BUF_LEN];
    uint8_t token[8] = {0x1, 0x2, 0x3, 0x4};
    uint8_t response_buf[MAX_BUF_LEN];
    struct coap_packet request;
    struct coap_packet response;
    int ret;

    sock = socket(AF_INET6, SOCK_DGRAM, IPPROTO_UDP);
    if (sock < 0) {
        LOG_ERR("Failed to create socket");
        return;
    }

    memset(&server_addr, 0, sizeof(server_addr));
    server_addr.sin6_family = AF_INET6;
    server_addr.sin6_port = htons(SERVER_PORT);
    inet_pton(AF_INET6, server_ip, &server_addr.sin6_addr);

    ret = coap_packet_init(&request, request_buf, sizeof(request_buf),
                           1, COAP_TYPE_CON, sizeof(token), &token,
                           COAP_METHOD_GET, coap_next_id());
    if (ret < 0) {
        LOG_ERR("Failed to init CoAP packet");
        close(sock);
        return;
    }

    coap_packet_append_option(&request, COAP_OPTION_URI_PATH, resource_path, strlen(resource_path));

    ret = sendto(sock, request.data, request.max_len, 0,
                 (struct sockaddr *)&server_addr, sizeof(server_addr));
    if (ret < 0) {
        LOG_ERR("Failed to send CoAP request");
        close(sock);
        return;
    }

    LOG_INF("CoAP request sent to [%s]/%s", server_ip, resource_path);

    struct sockaddr_in6 from_addr;
    socklen_t from_len = sizeof(from_addr);
    ret = recvfrom(sock, response_buf, sizeof(response_buf), 0,
                   (struct sockaddr *)&from_addr, &from_len);
    if (ret < 0) {
        LOG_ERR("Failed to receive response");
        close(sock);
        return;
    }

    ret = coap_packet_parse(&response, response_buf, ret, NULL, 0);
    if (ret < 0) {
        LOG_ERR("Failed to parse response");
        close(sock);
        return;
    }

    const uint8_t *payload = coap_packet_get_payload(&response, NULL);
    if (payload) {
        LOG_INF("Received payload: %s", payload);
    } else {
        LOG_WRN("No payload in response");
    }

    close(sock);
}
```

## src/coap_client.h
```c
#pragma once

void send_coap_request(const char *server_ip, const char *resource_path);
```

## src/coap_server.c
```c
#include <zephyr/net/coap.h>
#include <zephyr/net/socket.h>
#include <zephyr/net/net_pkt.h>
#include <zephyr/net/net_context.h>
#include <zephyr/logging/log.h>
#include "coap_server.h"


LOG_MODULE_REGISTER(coap_server, LOG_LEVEL_INF);

#define MY_PORT 5683
static int sock;

int coap_handler_request(struct coap_resource *resource,
                        struct coap_packet *request,
                        struct sockaddr *addr,
                        socklen_t addr_len)
{
    struct coap_packet response;
    uint8_t data[128];
    uint8_t token;
    int r;

    LOG_INF("Received CoAP request");

    r = coap_packet_init(&response, data, sizeof(data),
                         1, COAP_TYPE_ACK,
                         coap_header_get_token(request, &token),
                         &token,
                         COAP_RESPONSE_CODE_CONTENT,
                         coap_header_get_id(request));
    if (r < 0) {
        LOG_ERR("Failed to init response packet");
        return r;
    }

    coap_packet_append_payload_marker(&response);
    coap_packet_append_payload(&response, (uint8_t *)"Hello from Zephyr!", 18);

    sendto(sock, response.data, response.offset, 0, addr, addr_len);

    return 0;
}

static struct coap_resource resources[] = {
    { .get = coap_handler_request, .path = "hello", .user_data = NULL },
    { }
};

void start_coap_server(void)
{
    struct sockaddr_in6 addr6;
    int ret;

    sock = socket(AF_INET6, SOCK_DGRAM, IPPROTO_UDP);
    if (sock < 0) {
        LOG_ERR("Failed to create UDP socket");
        return;
    }
    printk("Starting Server\n");
    memset(&addr6, 0, sizeof(addr6));
    addr6.sin6_family = AF_INET6;
    addr6.sin6_port = htons(MY_PORT);
    addr6.sin6_addr = in6addr_any;

    ret = bind(sock, (struct sockaddr *)&addr6, sizeof(addr6));
    if (ret < 0) {
        LOG_ERR("Failed to bind socket");
        return;
    }

    LOG_INF("CoAP server listening on port %d", MY_PORT);

    while (1) {
        uint8_t buffer[128];
        struct sockaddr client_addr;
        socklen_t addr_len = sizeof(client_addr);
        int received = recvfrom(sock, buffer, sizeof(buffer), 0, &client_addr, &addr_len);
        if (received < 0) {
            continue;
        }

        struct coap_packet request;
        coap_packet_parse(&request, buffer, received, NULL, 0);

        coap_handler_request(&resources[0], &request, &client_addr, addr_len);
    }
}
```

## src/coap_server.h
```c
#pragma once

void start_coap_server();
```

## src/handler.c
```c
#include <string.h>
#include <zephyr/kernel.h>
#include "handler.h"
#include "errors.h"
#include "types.h"



static handler_node* head = NULL;

handler_node* create_hnode(char* name, mesh_handler *callback, handler_node* next) {
    if ((name == NULL) | (callback == NULL)) {
        return NULL;
    }

    handler_node *newNode = (handler_node*) malloc(sizeof(handler_node));
    if (newNode == NULL) {
        printk("Failed to malloc handler node.\n");
        return NULL;
    }

    strcpy(newNode->name, name);
    newNode->cb = callback;
    newNode->next = next;
    return newNode;
}

void delete_hnode(handler_node* node) {
    if (node == NULL) {
        return;
    }
    free(node->name);
    free(node);
}

int handler_add(char* name, mesh_handler *callback) {
    if (callback == NULL || name == NULL) {
        return ENULLARG;
    }
    handler_node* newHandler = create_hnode(name, callback, NULL);
    if (newHandler == NULL) {
        return ENOMEM_SYS;
    }

    if (head == NULL) {
        head = newHandler;
    } else {
        handler_node* curr = head;
        while (curr->next != NULL) {
            curr = curr->next;
        }
        curr->next = newHandler;
    }

    return 0;
}

void clear_handlers() {
    if (head == NULL) {
        return;
    }

    handler_node* curr = head;

    while (curr != NULL) {
        delete_hnode(curr);
        curr = curr->next;
    }

    head = NULL;
    return;
}

int ot_message_handle(meshMessage* messageToHandle) {
    if (messageToHandle == NULL) {
        return ENULLARG;
    }

    if (head == NULL) {
        return 0;
    }

    handler_node* curr = head;

    while (curr) {
        printk("Calling %s\n", curr->name);
        mesh_handler handler = *(curr->cb);
        handler(messageToHandle);
        curr = curr->next;
    }

    return 0;
}
```

## src/mesh.c
```c
#include <stdio.h>
#include <string.h>
#include <zephyr/kernel.h>
#include <zephyr/net/openthread.h>
#include <openthread/thread.h>
#include <openthread/coap.h>

#include "mesh.h"
#include "network.h"
#include "errors.h"
#include "types.h"
#include "handler.h"

static void coap_response_handler(void *t_context, otMessage *t_message, const otMessageInfo *t_message_info)
{
    otCoapCode messageCode = otCoapMessageGetCode(t_message);
    messageType messageType = otCoapMessageGetType(t_message);


    // Only Accept Data, not acknowledgemnts
    printk("Message Type: %d\n", messageType);
    if (messageType != CONFIRMABLE && messageType != NON_CONFIRMABLE ) {
        return;
    }


    meshMessage message;
    uint16_t text_length = otMessageGetLength(t_message);
    char text[text_length + 2];
    text_length = otMessageRead(t_message, otMessageGetOffset(t_message)+1, text, otMessageGetLength(t_message));
    text[text_length + 1] = '\0';
    printk("Message Content: %s\n", text);
    
    strcpy(message.message, text);
    message.size = (int) text_length;
    message.token = *otCoapMessageGetToken(t_message);


    ot_message_handle(&message);



    if (messageType == CONFIRMABLE) {
        //response goes here
        return;
    }
}

static otCoapResource main_handler = {
    .mUriPath = "mainhandler",
    .mHandler = coap_response_handler,
    .mContext = NULL,
    .mNext = NULL
};

int mesh_initialize() {
    int ret = initialize_coap();
    if (ret != 0) {
        return ret;
    }

    ret = configureIP();
    if (ret != 0) {
        return ret;
    }

    ret = addResourceHandler(&main_handler);
    if (ret != 0) {
        return ret;
    }

    
    printk("Main Handler was added successfully\n");
    // Default Function Handlers go here
    return 0;
}

int configureIP() {
    otInstance *t_instance = openthread_get_default_instance();
    otNetifAddress address;
    const otMeshLocalPrefix *mlp = otThreadGetMeshLocalPrefix(t_instance);
    uint8_t ip[8] = {0x00, 0x00, 0x00, 0x00, 0x00, 0x00, 0x00, 0x01};
    memcpy(&address.mAddress.mFields.m8[0], mlp, 8);
    memcpy(&address.mAddress.mFields.m8[8], ip, 8);

    otError error = otIp6AddUnicastAddress(t_instance, &address);

    if (error != OT_ERROR_NONE) {
        printk("Error configuring IPv6 Address: %d\n", error);
        return EOT_FAIL;
    }
    return 0;
}


int mesh_register_cb(char* name, mesh_handler *callback) {
    if (callback == NULL || name == NULL) {
        return ENULLARG;
    }

    int ret = handler_add(name, callback);
    if (ret != 0) {
        printk("Failed to init OT Handler: %s\n", name);
        return ret;
    }

    printk("Initialized OT Handler: %s\n", name);

    return 0;
}

int mesh_send(meshPacket *packet) {
    if (packet == NULL) {
        return ENULLARG;
    }
    otError error = OT_ERROR_NONE;
    otMessage *message;
    otMessageInfo messageInfo;
    otInstance *t_instance = openthread_get_default_instance();

    if (t_instance == NULL) {
        printk("Error with ot instance\n");
        return EOT_FAIL;
    }

    const otMeshLocalPrefix *mlp = otThreadGetMeshLocalPrefix(t_instance);
    
    message = otCoapNewMessage(t_instance, NULL);
    if (message == NULL) {
        printk("Failed Message Allocation");
        return EOT_FAIL;
    }

    otCoapMessageInit(message, packet->type, OT_COAP_CODE_PUT);

    error = otCoapMessageAppendUriPathOptions(message, "comms");
    if (error != OT_ERROR_NONE) {goto exit;}

    error = otCoapMessageAppendContentFormatOption(message, OT_COAP_OPTION_CONTENT_FORMAT_JSON);
    if (error != OT_ERROR_NONE) {goto exit;}

    error = otCoapMessageSetPayloadMarker(message);
    if (error != OT_ERROR_NONE) {goto exit;}

    error = otMessageAppend(message, packet->message, packet->message_size);
    if (error != OT_ERROR_NONE) {goto exit;}

    memset(&messageInfo, 0, sizeof(messageInfo));
    memcpy(&messageInfo.mPeerAddr.mFields.m8[0], mlp, 8);
    memcpy(&messageInfo.mPeerAddr.mFields.m8[8], packet->device_id, 8);
    messageInfo.mPeerPort = OT_DEFAULT_COAP_PORT;

    error = otCoapSendRequest(t_instance, message, &messageInfo, NULL, NULL);
    printk("CoAP Data Sent.\n");
exit:
    if (error != OT_ERROR_NONE) {
        printk("Failed to send CoAP Request: %d\n", error);
        otMessageFree(message);
        return EOT_FAIL;
    }
    
    return 0;
}

 
```

## src/network.c
```c
#include <stdio.h>
#include <zephyr/kernel.h>
#include <zephyr/net/openthread.h>
#include <openthread/thread.h>
#include <openthread/coap.h>

#include "network.h"
#include "errors.h"

#define TIMEOUT 1000


int initialize_coap() {
    otError error;
    otInstance *t_instance = openthread_get_default_instance();

    error = otCoapStart(t_instance, OT_DEFAULT_COAP_PORT);
    if (error != OT_ERROR_NONE) {
        printk("CoAP Initialization Fail: %d\n", error);
        return EOT_FAIL;
    }

    printk("CoAP Initialized Successfully\n");

    return 0;   
}

int deinitialize_coap() {
    otError error;
    otInstance *t_instance = openthread_get_default_instance();

    error = otCoapStop(t_instance);
    if (error != OT_ERROR_NONE) {
        printk("CoAP Initialization Fail: %d\n", error);
        return EOT_FAIL;
    }

    printk("CoAP Initialized Successfully\n");

    return 0;   
}

int addResourceHandler(otCoapResource *resource) {
    if (resource == NULL) {
        return ENULLARG;
    }

    otInstance *t_instance = openthread_get_default_instance();
    if (t_instance == NULL) {       // If instance isn't initalized, fail
        return EOT_NOINIT;
    }
    
    resource->mContext = t_instance;
    otCoapAddResource(t_instance, resource);

    return 0;
}
```

## src/peripherals.c
```c
#include <dk_buttons_and_leds.h>
#include <zephyr/kernel.h>
#include "types.h"
#include "peripherals.h"

static void buttonHandler(uint32_t button_state, uint32_t has_changed) {
    uint32_t buttons = button_state & has_changed;

    if (buttons & DK_BTN1_MSK) {
        // Function for Button 1
        meshPacket packet;
        packet.device_id[0] = 0x01;
        packet.message ="MESSAGE";
        packet.category = BROADCAST;
        packet.type = NON_CONFIRMABLE;
        mesh_send(&packet);
    }

    if (buttons & DK_BTN2_MSK) {
        // Function for Button 2
    }

    if (buttons & DK_BTN3_MSK) {
        // Function for Button 3
    }

    if (buttons & DK_BTN4_MSK) {
        // Function for Button 4
    }
}

void configurebutton() {
    int ret = dk_buttons_init(buttonHandler);
    if (ret) {
        printk("Button Initialization Failed (error: %d)", ret);
    }
}

void configureLED() {
    int ret = dk_leds_init();
    if (ret) {
        printk("LED Initialization Failed (error: %d)", ret);
    }
}

void testUTILS() {
    printk("Testing\n");
}
```
